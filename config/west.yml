## config/west.yml
```yaml
manifest:
  remotes:
    - name: zmkfirmware
      url-base: https://github.com/zmkfirmware
    - name: kumamuk-git
      url-base: https://github.com/kumamuk-git
    - name: badjeff
      url-base: https://github.com/badjeff
    - name: mctechnology17
      url-base: https://github.com/mctechnology17
    - name: eyelash
      url-base: https://github.com/a741725193
    - name: infused-kim
      url-base: https://github.com/infused-kim
    - name: a741725193
      url-base: https://github.com/a741725193
    - name: englmaxi
      url-base: https://github.com/englmaxi
    - name: zzeneg
      url-base: https://github.com/zzeneg
    - name: srwi
      url-base: https://github.com/srwi
  projects:
    - name: zmk
      remote: zmkfirmware
      revision: v0.3.0
      import: app/west.yml
    - name: zmk-pmw3610-driver
      remote: badjeff
      revision: main
    - name: zmk-nice-oled
      remote: mctechnology17
      revision: main
    - name: zmk-board-eyelash
      remote: eyelash
      revision: main
    - name: kb_zmk_ps2_mouse_trackpoint_driver
      remote: infused-kim
      revision: main
    - name: zmk-tog-io
      remote: a741725193
      revision: main
    - name: zmk-dongle-display
      remote: englmaxi
      revision: v0.3
    - name: zmk-raw-hid
      remote: zzeneg
      revision: main
    - name: zmk-keypeek-layer-notifier
      remote: srwi
      revision: split-support
  self:
    path: config
```
